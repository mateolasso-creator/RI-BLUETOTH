## bt_acceso/sdkconfig.defaults
```kconfig
# Configuración predeterminada para bt_acceso
# Estas configuraciones se pueden sobrescribir con menuconfig

# Bluetooth Configuration
CONFIG_BT_ENABLED=y
CONFIG_BT_CLASSIC_ENABLED=y
CONFIG_BT_BLUEDROID_ENABLED=y
CONFIG_BT_BLUEDROID_CLASSIC_BT=y
CONFIG_BT_CLASSIC_QOS_ENABLED=y
CONFIG_BT_CLASSIC_SPP_ENABLED=y

# Bluetooth Controller Mode - BR/EDR Only
CONFIG_BT_CTRL_MODE_ESCO_ONLY=n
CONFIG_BT_CTRL_MODE_BR_EDR_ONLY=y

# SPP Profile
CONFIG_BT_SPP_ENABLED=y

# Allocate memory for Bluetooth
CONFIG_BT_ALLOCATION_FROM_SPIRAM_FIRST=n
CONFIG_BT_QUEUE_LEN=10

# Bluetooth Logging
CONFIG_BT_LOG_COLOR=y
CONFIG_BT_LOG_SYS_LEVEL=3
```
